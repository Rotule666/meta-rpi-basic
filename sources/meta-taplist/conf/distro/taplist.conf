## sources/meta-taplist/conf/distro/taplist.conf
```bitbake
# Distribution Informations

include conf/distro/poky.conf

# Versions
LOCALCONF_VERSION = "1"

DISTRO = "taplist"
DISTRO_NAME = "taplist"
DISTRO_VERSION = "0.0.2-dev"
SDK_VENDOR = "-sdk"
SDK_VERSION := "${DISTRO_VERSION}"
TARGET_VENDOR = "-rotule666"
TOOLCHAIN_HOST_TASK_append += "nativesdk-cmake"

# Change hostname
hostname_pn-base-files = "taplist"
PACKAGE_INSTALL_append = " psplash-taplist"

# Set distro features
DISTRO_FEATURES_append = " systemd"
VIRTUAL-RUNTIME_init_manager = "systemd"
DISTRO_FEATURES_BACKFILL_CONSIDERED = "sysvinit"
VIRTUAL-RUNTIME_initscripts = ""
IMX_DEFAULT_DISTRO_FEATURES_append = " systemd"

# Remove conflicting backends.
DISTRO_FEATURES_remove = "wayland directfb vulkan "

IMAGE_FSTYPES = "rpi-sdimg rpi-sdimg.bmap"
```

## sources/meta-taplist/conf/layer.conf
```bitbake
# We have a conf and classes directory, add to BBPATH
BBPATH .= ":${LAYERDIR}"

# We have recipes-* directories, add to BBFILES
BBFILES += "${LAYERDIR}/recipes-*/*/*.bb \
            ${LAYERDIR}/recipes-*/*/*.bbappend"

BBFILE_COLLECTIONS += "meta-taplist"
BBFILE_PATTERN_meta-taplist = "^${LAYERDIR}/"
BBFILE_PRIORITY_meta-taplist = "6"

LAYERDEPENDS_meta-taplist = "core"
LAYERSERIES_COMPAT_meta-taplist = "dunfell"
```
